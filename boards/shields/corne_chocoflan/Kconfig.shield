## boards/shields/corne_chocoflan/Kconfig.shield
```kconfig
config SHIELD_CORNE_CHOCOFLAN_DONGLE
  def_bool $(shields_list_contains,corne_chocoflan_dongle)
```

## config/boards/shields/chocoflan/Kconfig.defconfig
```kconfig
if SHIELD_CHOCOFLAN_DONGLE

config ZMK_KEYBOARD_NAME
    default "chocoflan"

config ZMK_SPLIT_ROLE_CENTRAL
    default y

config ZMK_USB
	default y

endif

if SHIELD_CHOCOFLAN_LEFT || SHIELD_CHOCOFLAN_RIGHT || SHIELD_CHOCOFLAN_DONGLE 

config ZMK_SPLIT
	default y

config ZMK_BLE
	default y
	
endif

if ZMK_DISPLAY

config I2C
    default y

config SSD1306
    default y

endif
```

## config/boards/shields/chocoflan/Kconfig.shield
```kconfig
config SHIELD_CHOCOFLAN_LEFT
  def_bool $(shields_list_contains,chocoflan_left)

config SHIELD_CHOCOFLAN_RIGHT
  def_bool $(shields_list_contains,chocoflan_right)

config SHIELD_CHOCOFLAN_DONGLE
  def_bool $(shields_list_contains,chocoflan_dongle)
```
